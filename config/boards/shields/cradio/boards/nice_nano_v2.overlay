
// The PS/2 GPIO and mouse drivers.
/ {
    gpio_ps2: gpio_ps2 {
		status = "disabled";
        compatible = "gpio-ps2";

        // The two bottom left pins of the nice!nano (when it is facing down)
        scl-gpios = <&gpio0 1>;
        sda-gpios = <&gpio0 2>;
    };
};

/ {
    mouse_ps2: mouse_ps2 {
		status = "disabled";
        compatible = "zmk,mouse-ps2";
        ps2-device = <&gpio_ps2 >;

        // Uncomment this if you have an extra free pin and
        // want the controller to perform the Power-On-Reset
        // instead of using a reset circuit.
        //
        // The bottom right pin of the nice!nano (when it is facing down)
        rst-gpios = <&gpio1 7>;
    };
};
