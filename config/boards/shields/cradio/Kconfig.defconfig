## config/boards/shields/cradio/Kconfig.defconfig
```kconfig
# Copyright (c) 2020 The ZMK Contributors
# SPDX-License-Identifier: MIT

CONFIG_ZMK_EXT_POWER=y

if SHIELD_CRADIO_RIGHT

config ZMK_KEYBOARD_NAME
    default "cradio-tp"

config ZMK_SPLIT_ROLE_CENTRAL=y

endif

if SHIELD_CRADIO_LEFT

config ZMK_SPLIT_ROLE_CENTRAL=n

endif

if SHIELD_CRADIO_LEFT || SHIELD_CRADIO_RIGHT

config ZMK_SPLIT
    default y

endif
```

## config/boards/shields/sweep/Kconfig.defconfig
```kconfig
# Copyright (c) 2020 The ZMK Contributors
# SPDX-License-Identifier: MIT

if SHIELD_sweep_DONGLE

config ZMK_KEYBOARD_NAME
	default "sweep Dongle"
	
config ZMK_SPLIT_BLE_ROLE_CENTRAL
	default y
	
config ZMK_USB
	default y

endif

if SHIELD_sweep_LEFT || SHIELD_sweep_RIGHT || SHIELD_sweep_DONGLE 

config ZMK_SPLIT
	default y

config ZMK_BLE
	default y
	
endif
```

## config/boards/shields/sweep/Kconfig.shield
```kconfig
# Copyright (c) 2020 The ZMK Contributors
# SPDX-License-Identifier: MIT

config SHIELD_sweep_LEFT
	def_bool $(shields_list_contains,sweep_left)

config SHIELD_sweep_RIGHT
	def_bool $(shields_list_contains,sweep_right)

config SHIELD_sweep_DONGLE
	def_bool $(shields_list_contains,sweep_dongle)
```

## config/west.yml
```yaml
manifest:
  remotes:
    - name: zmkfirmware
      url-base: https://github.com/zmkfirmware
   
  projects:
    - name: zmk
  
      revision: main
      import: app/west.yml
  self:
    path: config
```
