/*
 * Copyright (c) 2020 The ZMK Contributors
 *
 * SPDX-License-Identifier: MIT
 */

#include "cradio.dtsi"

&default_transform {
    col-offset = <17>;
};

// Put this in the overlay of the central side (usually left).
// The mouse driver doesn't work on the peripheral.
// If you have your trackpoint on the right side, you need to
// make it the central side first.
//
// Check the Kconfig.defconfig and the `ZMK_SPLIT_ROLE_CENTRAL`
// setting.
&gpio_ps2 {
	status = "okay";
};

&mouse_ps2 {
	status = "okay";
};

// Adjust GPIO interrupt priority to the highest level.
// PS/2 events must be processed within 30-50us. Therefore we change the
// default gpio priority to the highest and we demote all BT interrupt
// priorities by one level.
//
// This allows the PS/2 interrupts to be triggered in time.
&gpiote {
	interrupts = < 0x6 0 >;



  // The PS/2 GPIO and mouse drivers.
  / {
      gpio_ps2: gpio_ps2 {
  		status = "enabled";
          compatible = "gpio-ps2";

          // The two bottom left pins of the nice!nano (when it is facing down)
          scl-gpios = <&gpio0 1>;
          sda-gpios = <&gpio0 2>;
      };
  };

  / {
      mouse_ps2: mouse_ps2 {
  		status = "enabled";
          compatible = "zmk,mouse-ps2";
          ps2-device = <&gpio_ps2 >;

          // Uncomment this if you have an extra free pin and
          // want the controller to perform the Power-On-Reset
          // instead of using a reset circuit.
          //
          // The bottom right pin of the nice!nano (when it is facing down)
          rst-gpios = <&gpio1 7>;
      };
  };
